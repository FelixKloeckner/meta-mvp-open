## meta-raspidisplay/conf/layer.conf
```bitbake
# We have a conf and classes directory, add to BBPATH
BBPATH .= ":${LAYERDIR}"

# We have recipes-* directories, add to BBFILES
BBFILES += "${LAYERDIR}/recipes-*/*/*.bb \
            ${LAYERDIR}/recipes-*/*/*.bbappend"

BBFILE_COLLECTIONS += "meta-raspidisplay"
BBFILE_PATTERN_meta-raspidisplay = "^${LAYERDIR}/"
BBFILE_PRIORITY_meta-raspidisplay = "11"

LAYERDEPENDS_meta-raspidisplay = "karo-nxp"
LAYERSERIES_COMPAT_meta-raspidisplay = "kirkstone"
```
